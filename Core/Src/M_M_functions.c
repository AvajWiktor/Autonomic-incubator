#include <M_M_functions.h>

/* FUNKCJA PRZETWARZANIA DANYCH PRZEZ PID */
//NA WEJSCIE PRZEKAZUJEMY:(Z zakresu 0-1400)WARTOSC ZADANA, ODCZYT Z CZUNIKA, INSTANCJE SAMEGO PID
void SetValue(int in, int out, arm_pid_instance_f32 * PID_INSTANCE)
{
	int return_value; // ZWRACANA WARTOSC

//FUNKCJA REGULATORA PID ZWRACAJACA WYNIK REGULACJI,
//NA WEJSCIE PRZEKAZUJEMY INSTANCJE PID ORAZ UCHYB(roznice war zadanej  i war odczytanej)
	return_value = arm_pid_f32(PID_INSTANCE, in - out);

	/* WARUNEK OGRANICZENIA WARTOSCI */

	if (return_value < 0)
	{
		return_value = 0;
	}
	else if (return_value > 1000)
	{
	return_value = 1000;
	}
// USTAWIANIE WARTOSCI PWMA ZALEZNIE OD OTRZYMANEJ REGULACJI
	__HAL_TIM_SET_COMPARE(&htim3, TIM_CHANNEL_3, return_value);
}

//---------------------------------------------------------------------------

/* FUNKCJA ODCZYTUJACA DANE Z CZUJNIKA */
int ReadData()
{
	float dataf;
	int data;
	BH1750_ReadLight(&dataf); //ODCZYT WARTOSCI DO PRZEKAZANEJ ZMIENNEJ
	data = dataf;
	return data;
}
//---------------------------------------------------------------------------

/* FUNKCJA AKTUALIZUJACA LCD W CELU UNIKNIECIA POZOSTAWIANIA STARYCH DANYCH */
void RefreshLCD(float in, float out) // PRZEKAZUJEM DO FUNKCJI WARTOSC ZADANA ORAZ ODCZYT Z CZUJNIKA Z ZAKRESU 0-1400
{
		  char msg[16]; // TWORZYMY BUFOR W KTORYM BEDZIE PRZECHOWYWANA WIADOMOSC (MAX 16 ZNAKOW, PONIEWAZ TYLE MIESCI SIE NA EKRANIE LCD)
		  lcd_clear(); // CZYSCIMY EKRAN PRZED WPROWADZENIEM NOWYCH DANYCH
		  lcd_put_cur(0, 0); // USTAWIAMY MIEJSCE ROZPOCZECIA ZAPISU WIADOMOSCI NA EKRANIE (PIERWSZY RZAD PIERWSZA KOLUMNA)
		  if(in > 1400) // JEZELI WARTOSC ZADANA PRZEKRACZA ZAKRES PRACY REGULATORA, WYSWIETLANY JEST ODPOWIEDNI KOMUNIKAT
		  {
			  lcd_send_string("Out of range!");
		  }
		  else if(in<0)
		  {
			  lcd_send_string("It burns xD");
		  }
		  else // W PRZYPADKU POPRAWNEJ WARTOSCI, WYSWIETLANA JEST INFORMACJA O AKTUALNYCH WARTOSCIACH ZADANYCH I ODCZYTU
		  {
		  sprintf(&msg, "Temp: %.1f [C]", in); //ZA POMOCA FUNKCJI sprintf ZAPISUJEMY DO WIADOMOSCI "SET: " ORAZ WARTOSCI CALKOWITA POPRZEZ DODANIE "%d"
		  lcd_send_string(msg); //WYSYLAMY UTWORZONA PRZEZ NAS WCZESNIEJ WIADOMOSC PRZEKAZUJAC JA DO FUNKCJI
		  lcd_put_cur(1, 0); //USTAWIAMY WSKAZNIK NA DRUGI RZAD I 1 KOLUMNE
		  sprintf(&msg, "Wilg: %.1f [%%]", out); //PONOWNIE ZAPISUJEMY DO TABLICY msg WIADOMOSC, TYM RAZEM WARTOSCI ODCZYTANEJ Z CZUJNIKA
		  lcd_send_string(msg); // WYSYLAMY WIADOMOSC DO WYSWIETLENIA
		  }
}
void RefreshLCD_3v(float in, float out, int nr3) // PRZEKAZUJEM DO FUNKCJI WARTOSC ZADANA ORAZ ODCZYT Z CZUJNIKA Z ZAKRESU 0-1400
{
		  char msg[16]; // TWORZYMY BUFOR W KTORYM BEDZIE PRZECHOWYWANA WIADOMOSC (MAX 16 ZNAKOW, PONIEWAZ TYLE MIESCI SIE NA EKRANIE LCD)
		  lcd_clear(); // CZYSCIMY EKRAN PRZED WPROWADZENIEM NOWYCH DANYCH
		  lcd_put_cur(0, 0); // USTAWIAMY MIEJSCE ROZPOCZECIA ZAPISU WIADOMOSCI NA EKRANIE (PIERWSZY RZAD PIERWSZA KOLUMNA)
		  if(in > 1400) // JEZELI WARTOSC ZADANA PRZEKRACZA ZAKRES PRACY REGULATORA, WYSWIETLANY JEST ODPOWIEDNI KOMUNIKAT
		  {
			  lcd_send_string("Out of range!");
		  }
		  else if(in<0)
		  {
			  lcd_send_string("It burns xD");
		  }
		  else // W PRZYPADKU POPRAWNEJ WARTOSCI, WYSWIETLANA JEST INFORMACJA O AKTUALNYCH WARTOSCIACH ZADANYCH I ODCZYTU
		  {
		  sprintf(&msg, "T:%.1fC H:%.1f%%", in,out); //ZA POMOCA FUNKCJI sprintf ZAPISUJEMY DO WIADOMOSCI "SET: " ORAZ WARTOSCI CALKOWITA POPRZEZ DODANIE "%d"
		  lcd_send_string(msg); //WYSYLAMY UTWORZONA PRZEZ NAS WCZESNIEJ WIADOMOSC PRZEKAZUJAC JA DO FUNKCJI
		  lcd_put_cur(1, 0); //USTAWIAMY WSKAZNIK NA DRUGI RZAD I 1 KOLUMNE
		  sprintf(&msg, "L: %d[LUX]", nr3); //PONOWNIE ZAPISUJEMY DO TABLICY msg WIADOMOSC, TYM RAZEM WARTOSCI ODCZYTANEJ Z CZUJNIKA
		  lcd_send_string(msg); // WYSYLAMY WIADOMOSC DO WYSWIETLENIA
		  }
}
